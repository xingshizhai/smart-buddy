## main/Kconfig.projbuild
```kconfig
menu "Smart-Buddy Configuration"

    menu "Transport Layer"

        config TRANSPORT_BLE_ENABLED
            bool "Enable BLE (Nordic UART Service)"
            default y
            select BT_ENABLED
            select BT_NIMBLE_ENABLED

        config TRANSPORT_BLE_DEVICE_NAME
            string "BLE Advertised Name"
            default "Claude Buddy"
            depends on TRANSPORT_BLE_ENABLED

        config TRANSPORT_BLE_REQUIRE_BONDING
            bool "Require BLE Secure Connection bonding"
            default n
            depends on TRANSPORT_BLE_ENABLED

        config TRANSPORT_WS_ENABLED
            bool "Enable Wi-Fi WebSocket transport"
            default y

        config TRANSPORT_WS_MODE_CLIENT
            bool "WebSocket client mode (connect to server)"
            default y
            depends on TRANSPORT_WS_ENABLED

        config TRANSPORT_WS_DEFAULT_URL
            string "Default WebSocket server URL"
            default "ws://192.168.2.195:8080/buddy"
            depends on TRANSPORT_WS_ENABLED && TRANSPORT_WS_MODE_CLIENT

        config TRANSPORT_WS_SERVER_PORT
            int "WebSocket server listen port"
            default 8080
            depends on TRANSPORT_WS_ENABLED

        config TRANSPORT_USB_ENABLED
            bool "Enable USB CDC-ACM serial transport"
            default y

    endmenu

    menu "Protocol Adapters"

        choice BUDDY_MODE
            prompt "Buddy Protocol Mode"
            default BUDDY_MODE_CLAUDE

            config BUDDY_MODE_CLAUDE
                bool "Claude Buddy (compatible with claude-desktop-buddy)"

            config BUDDY_MODE_OPENCLAW
                bool "OpenClaw Buddy"

            config BUDDY_MODE_HERMES
                bool "Hermes Buddy"

        endchoice

        # Hidden derived configs — preserve existing #if guards in source files
        config PROTO_CLAUDE_BUDDY_ENABLED
            bool
            default y if BUDDY_MODE_CLAUDE

        config PROTO_OPENCLAW_ENABLED
            bool
            default y if BUDDY_MODE_OPENCLAW

        config PROTO_HERMES_ENABLED
            bool
            default y if BUDDY_MODE_HERMES

        config PROTO_DEFAULT
            string
            default "claude_buddy" if BUDDY_MODE_CLAUDE
            default "openclaw"     if BUDDY_MODE_OPENCLAW
            default "hermes"       if BUDDY_MODE_HERMES

        config PROTO_TOKEN_MILESTONE
            int "Token count for celebrate milestone"
            default 50000

    endmenu

    menu "Wi-Fi"

        config SB_WIFI_SSID
            string "Default Wi-Fi SSID"
            default ""

        config SB_WIFI_PASSWORD
            string "Default Wi-Fi Password"
            default ""

    endmenu

    menu "IMU Gestures"

        config IMU_SHAKE_THRESHOLD_MG
            int "Shake detection threshold in milli-g (1000 = 1g)"
            default 1500

        config IMU_FACE_DOWN_THRESHOLD_MG
            int "Face-down Z-axis threshold in milli-g"
            default 850

    endmenu

    menu "UI Behavior"

        config UI_SCREEN_OFF_TIMEOUT_S
            int "Screen off timeout in seconds (0 = disabled)"
            default 30

        config UI_APPROVAL_TIMEOUT_S
            int "Approval auto-deny timeout in seconds"
            default 30

        config UI_HEART_DURATION_MS
            int "Heart state display duration in ms"
            default 2000

        config UI_CELEBRATE_DURATION_MS
            int "Celebrate state display duration in ms"
            default 3000

        config UI_DIZZY_DURATION_MS
            int "Dizzy state display duration in ms"
            default 2000

    endmenu

endmenu
```

## sdkconfig.defaults
```kconfig
CONFIG_ESPTOOLPY_FLASHSIZE_16MB=y
CONFIG_PARTITION_TABLE_CUSTOM=y
CONFIG_PARTITION_TABLE_CUSTOM_FILENAME="partitions.csv"
CONFIG_ESPTOOLPY_FLASHMODE_QIO=y
CONFIG_ESPTOOLPY_FLASHFREQ_80M=y

CONFIG_SPIRAM=y
CONFIG_SPIRAM_MODE_OCT=y
CONFIG_SPIRAM_SPEED_80M=y
CONFIG_SPIRAM_USE_MALLOC=y
CONFIG_SPIRAM_MALLOC_ALWAYSINTERNAL=16384

CONFIG_ESP_TASK_WDT_TIMEOUT_S=30
CONFIG_MAIN_TASK_STACK_SIZE=8192

CONFIG_BT_ENABLED=y
CONFIG_BT_NIMBLE_ENABLED=y
CONFIG_BT_NIMBLE_ROLE_PERIPHERAL=y
CONFIG_BT_NIMBLE_ROLE_BROADCASTER=y
# Disable unused roles to save memory
CONFIG_BT_NIMBLE_ROLE_CENTRAL=n
CONFIG_BT_NIMBLE_ROLE_OBSERVER=n
CONFIG_BT_NIMBLE_MAX_CONNECTIONS=1
CONFIG_BT_NIMBLE_SVC_GAP_DEVICE_NAME="SmartBuddy"
CONFIG_BT_NIMBLE_SM_SC=y
CONFIG_BT_NIMBLE_SM_BONDING=y
CONFIG_BT_NIMBLE_SM_MITM=y
CONFIG_BT_NIMBLE_HOST_TASK_STACK_SIZE=5120
# NimBLE memory from PSRAM — internal SRAM too small for BLE + all other tasks
CONFIG_BT_NIMBLE_MEM_ALLOC_MODE_EXTERNAL=y

CONFIG_LOG_DEFAULT_LEVEL_INFO=y
CONFIG_LOG_MAXIMUM_LEVEL_DEBUG=y

CONFIG_FREERTOS_HZ=1000
CONFIG_FREERTOS_USE_TRACE_FACILITY=y

CONFIG_HTTPD_WS_SUPPORT=y

CONFIG_TINYUSB_ENABLED=y
CONFIG_TINYUSB_CDC_ENABLED=y

CONFIG_NVS_ENCRYPTION=n



CONFIG_LV_FONT_MONTSERRAT_16=y
CONFIG_LV_FONT_MONTSERRAT_24=y
CONFIG_LV_FONT_UNSCII_8=y

CONFIG_TRANSPORT_BLE_ENABLED=y
CONFIG_TRANSPORT_WS_ENABLED=y
CONFIG_TRANSPORT_USB_ENABLED=y
CONFIG_BUDDY_MODE_CLAUDE=y
CONFIG_PROTO_TOKEN_MILESTONE=50000
CONFIG_IMU_SHAKE_THRESHOLD_MG=1500
CONFIG_IMU_FACE_DOWN_THRESHOLD_MG=850
CONFIG_UI_SCREEN_OFF_TIMEOUT_S=30
CONFIG_UI_APPROVAL_TIMEOUT_S=30
CONFIG_UI_HEART_DURATION_MS=2000
CONFIG_UI_CELEBRATE_DURATION_MS=3000
CONFIG_UI_DIZZY_DURATION_MS=2000
```
